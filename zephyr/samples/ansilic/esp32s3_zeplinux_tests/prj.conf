## CMakeLists.txt
```
# SPDX-License-Identifier: Apache-2.0
cmake_minimum_required(VERSION 3.20.0)
find_package(Zephyr REQUIRED HINTS $ENV{ZEPHYR_BASE})
project(esp32s3_zeplinux_tests)

target_sources(app PRIVATE
    src/main.c
    src/test_process.c
)
```

## prj.conf
```kconfig
# zepLinux tests on ESP32 family (process / thread API)

# --- ztest ---
CONFIG_ZTEST=y
CONFIG_ZTEST_VERIFY_RUN_ALL=y
CONFIG_LOG=n
CONFIG_TEST_LOGGING_DEFAULTS=n

# --- zepLinux process model ---
CONFIG_PROCESS_MODEL=y
CONFIG_MAX_PROCESS_COUNT=8
CONFIG_MAX_FD_PER_PROCESS=8

# --- shell disabled (needs zepLinux signal/kill for Ctrl+C) ---

# --- memory / threads ---
CONFIG_MAIN_STACK_SIZE=4096
CONFIG_HEAP_MEM_POOL_SIZE=16384
CONFIG_DYNAMIC_THREAD=y
CONFIG_THREAD_STACK_INFO=y
CONFIG_NUM_PREEMPT_PRIORITIES=15

CONFIG_BOOT_BANNER=n
CONFIG_CONSOLE=y
CONFIG_UART_CONSOLE=y
CONFIG_SERIAL=y
CONFIG_PRINTK=y
```

## esp32c6_usb_console.overlay
```dts
/* ESP32-C6: console on USB-Serial-JTAG (the USB port on DevKitC) */
&usb_serial {
	status = "okay";
};

/ {
	chosen {
		zephyr,console = &usb_serial;
		zephyr,shell-uart = &usb_serial;
	};
};
```

## src/main.c
```c
/* zepLinux test runner — ESP32 family */
#include <zephyr/ztest.h>
#include <zephyr/kernel.h>
#include <zephyr/sys/printk.h>

ZTEST_SUITE(zeplinux_process, NULL, NULL, NULL, NULL, NULL);

void test_main(void)
{
	printk("zepLinux: test_main entry\n");
	k_msleep(50);
	ztest_run_all(NULL, false, 1, 1);
	printk("zepLinux: test_main done\n");
}
```

## src/test_process.c
```c
/* zepLinux kernel / process-model smoke tests (no newlib pthread) */
#include <zephyr/ztest.h>
#include <zephyr/kernel.h>
#include <zephyr/sys/printk.h>

#define STACK_SZ 1024
static K_THREAD_STACK_DEFINE(worker_stack, STACK_SZ);
static struct k_thread worker_thread;
static volatile int g_worker_done;

static void worker_entry(void* a, void* b, void* c)
{
	ARG_UNUSED(a);
	ARG_UNUSED(b);
	ARG_UNUSED(c);
	g_worker_done = 1;
}

ZTEST(zeplinux_process, test_current_thread)
{
	k_tid_t tid = k_current_get();
	zassert_not_null(tid, "current thread");
	printk("current thread ok\n");
}

ZTEST(zeplinux_process, test_kthread_join_like)
{
	g_worker_done = 0;
	k_tid_t tid = k_thread_create(&worker_thread, worker_stack, STACK_SZ,
				      worker_entry, NULL, NULL, NULL,
				      K_PRIO_PREEMPT(5), 0, K_NO_WAIT);
	zassert_not_null(tid, "k_thread_create");
	/* wait for flag */
	for (int i = 0; i < 50 && !g_worker_done; i++) {
		k_msleep(2);
	}
	zassert_equal(g_worker_done, 1, "worker should have run");
	printk("kthread ok\n");
}

ZTEST(zeplinux_process, test_sleep_ms)
{
	int64_t t0 = k_uptime_get();
	k_msleep(20);
	int64_t dt = k_uptime_get() - t0;
	zassert_true(dt >= 15, "sleep too short: %lld", (long long)dt);
	printk("k_msleep ok dt=%lld\n", (long long)dt);
}

ZTEST(zeplinux_process, test_fifo_sem)
{
	struct k_sem sem;
	k_sem_init(&sem, 0, 1);
	zassert_equal(k_sem_count_get(&sem), 0, "sem empty");
	k_sem_give(&sem);
	zassert_equal(k_sem_count_get(&sem), 1, "sem given");
	printk("sem ok\n");
}
```
