## CMakeLists.txt
```
# SPDX-License-Identifier: Apache-2.0

cmake_minimum_required(VERSION 3.20.0)

find_package(Zephyr REQUIRED HINTS $ENV{ZEPHYR_BASE})
project(esp32s3_zeplinux_shell)

target_sources(app PRIVATE
    src/main.c
    src/shell_process.c
    src/commands.c
    src/debug.c
    src/bytecode_vm.c
    src/anl_loader.c
    src/signal.c
    src/vfs_stub.c
)

# VFS commands disabled until POSIX types are fixed on ESP32-S3
#    src/vfs_commands.c
```

## prj.conf
```kconfig
# Shell configuration
CONFIG_SHELL=y
CONFIG_SHELL_BACKEND_SERIAL=y
CONFIG_SHELL_BACKEND_SERIAL_API_POLLING=y
CONFIG_SHELL_BACKEND_SERIAL_RX_POLL_PERIOD=10
CONFIG_SHELL_PROMPT_UART="shell> "
CONFIG_SHELL_CMD_BUFF_SIZE=4096
CONFIG_SHELL_PRINTF_BUFF_SIZE=256

# Process support
CONFIG_PROCESS_MODEL=y
CONFIG_MAX_PROCESS_COUNT=32
CONFIG_MAX_FD_PER_PROCESS=16

# Memory configuration
CONFIG_MAIN_STACK_SIZE=2048
CONFIG_SHELL_STACK_SIZE=2048

# Thread configuration
CONFIG_NUM_PREEMPT_PRIORITIES=15

# Logging (disable to avoid conflicts with shell)
CONFIG_LOG=n
CONFIG_BOOT_BANNER=n

# System configuration
CONFIG_CONSOLE=y
# CONFIG_CONSOLE_GETCHAR is not available on ESP32-S3 (use UART console)
CONFIG_UART_CONSOLE=y
CONFIG_SERIAL=y
CONFIG_PRINTK=y
CONFIG_REBOOT=y

# Dynamic memory
CONFIG_DYNAMIC_THREAD=y
CONFIG_THREAD_STACK_INFO=y
CONFIG_THREAD_NAME=y

# VFS / RAMFS — temporarily disabled on ESP32-S3 (POSIX types clash with newlib)
# CONFIG_FILE_SYSTEM=y
# CONFIG_VFS_CORE=y
# CONFIG_RAMFS=y
CONFIG_HEAP_MEM_POOL_SIZE=24576
```

## src/vfs_stub.c
```c
// VFS stubs for ESP32-S3 (ramfs/VFS temporarily disabled)
#include <zephyr/kernel.h>
#include <stddef.h>
#include <stdint.h>

int cmd_ls_vfs(int argc, char** argv) {
    ARG_UNUSED(argc);
    ARG_UNUSED(argv);
    printk("ls: VFS disabled on this build\n");
    return 0;
}

// Minimal POSIX-ish FS API stubs used by shell commands
int fs_open(const char* path, int flags, ...) {
    ARG_UNUSED(path);
    ARG_UNUSED(flags);
    return -1;
}

int fs_write(int fd, const void* buf, size_t len) {
    ARG_UNUSED(fd);
    ARG_UNUSED(buf);
    ARG_UNUSED(len);
    return -1;
}

int fs_close(int fd) {
    ARG_UNUSED(fd);
    return -1;
}
```
